## examples/build/ESP32/03-sftp-selib/main/Kconfig.projbuild
```kconfig
menu "SharkSSH ESP32 example"

    config SHARKSSH_ESP_PORT
        int "SSH server port"
        range 1 65535
        default 22

    config SHARKSSH_ESP_STORAGE_MOUNT_POINT
        string "SFTP FAT filesystem mount point"
        default "/ssh"

    config SHARKSSH_ESP_MAX_OPEN_FILES
        int "Maximum open FAT files"
        range 4 32
        default 12

    config SHARKSSH_ESP_FORMAT_STORAGE_IF_MOUNT_FAILED
        bool "Format storage when mounting fails"
        default y

    config SHARKSSH_ESP_ETH_MDC_GPIO
        int "Ethernet MDC GPIO"
        default 31

    config SHARKSSH_ESP_ETH_MDIO_GPIO
        int "Ethernet MDIO GPIO"
        default 52

    config SHARKSSH_ESP_ETH_PHY_ADDR
        int "Ethernet PHY address"
        range -1 31
        default 1

    config SHARKSSH_ESP_ETH_PHY_RST_GPIO
        int "Ethernet PHY reset GPIO"
        default 51

    config SHARKSSH_ESP_ETH_RMII_CLK_GPIO
        int "RMII reference clock input GPIO"
        default 50

    config SHARKSSH_ESP_ETH_RMII_TX_EN_GPIO
        int "RMII TX_EN GPIO"
        default 49

    config SHARKSSH_ESP_ETH_RMII_TXD0_GPIO
        int "RMII TXD0 GPIO"
        default 34

    config SHARKSSH_ESP_ETH_RMII_TXD1_GPIO
        int "RMII TXD1 GPIO"
        default 35

    config SHARKSSH_ESP_ETH_RMII_CRS_DV_GPIO
        int "RMII CRS_DV GPIO"
        default 28

    config SHARKSSH_ESP_ETH_RMII_RXD0_GPIO
        int "RMII RXD0 GPIO"
        default 29

    config SHARKSSH_ESP_ETH_RMII_RXD1_GPIO
        int "RMII RXD1 GPIO"
        default 30

endmenu
```

## examples/build/ESP32/03-sftp-selib/sdkconfig.defaults
```kconfig
CONFIG_ESP_MAIN_TASK_STACK_SIZE=32768
CONFIG_ETH_ENABLED=y
CONFIG_ETH_USE_ESP32_EMAC=y
CONFIG_ESPTOOLPY_FLASHSIZE_4MB=y
CONFIG_PARTITION_TABLE_CUSTOM=y
CONFIG_PARTITION_TABLE_CUSTOM_FILENAME="partitions.csv"
CONFIG_FATFS_LFN_HEAP=y
CONFIG_FATFS_MAX_LFN=255
CONFIG_FATFS_FS_LOCK=12
```
